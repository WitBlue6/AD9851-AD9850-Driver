/**
 * @cliArgs --device "MSPM0G350X" --package "LQFP-64(PM)" --part "Default" --product "mspm0_sdk@2.01.00.03"
 * @versions {"tool":"1.20.0+3587"}
 */

/**
 * Import the modules used in this configuration.
 */
const GPIO   = scripting.addModule("/ti/driverlib/GPIO", {}, false);
const GPIO1  = GPIO.addInstance();
const GPIO2  = GPIO.addInstance();
const GPIO3  = GPIO.addInstance();
const SYSCTL = scripting.addModule("/ti/driverlib/SYSCTL");

/**
 * Write custom configuration values to the imported modules.
 */
GPIO1.$name                          = "DATA";
GPIO1.associatedPins.create(8);
GPIO1.associatedPins[0].$name        = "D0";
GPIO1.associatedPins[0].assignedPort = "PORTA";
GPIO1.associatedPins[0].assignedPin  = "15";
GPIO1.associatedPins[1].$name        = "D1";
GPIO1.associatedPins[1].assignedPort = "PORTA";
GPIO1.associatedPins[1].assignedPin  = "16";
GPIO1.associatedPins[2].$name        = "D2";
GPIO1.associatedPins[2].assignedPort = "PORTA";
GPIO1.associatedPins[2].assignedPin  = "17";
GPIO1.associatedPins[3].$name        = "D3";
GPIO1.associatedPins[3].assignedPort = "PORTA";
GPIO1.associatedPins[3].assignedPin  = "24";
GPIO1.associatedPins[4].$name        = "D4";
GPIO1.associatedPins[4].assignedPort = "PORTA";
GPIO1.associatedPins[4].assignedPin  = "18";
GPIO1.associatedPins[5].$name        = "D5";
GPIO1.associatedPins[5].assignedPort = "PORTB";
GPIO1.associatedPins[5].assignedPin  = "18";
GPIO1.associatedPins[6].$name        = "D6";
GPIO1.associatedPins[6].assignedPort = "PORTA";
GPIO1.associatedPins[6].assignedPin  = "22";
GPIO1.associatedPins[7].$name        = "D7";
GPIO1.associatedPins[7].assignedPort = "PORTA";
GPIO1.associatedPins[7].assignedPin  = "8";

const Board = scripting.addModule("/ti/driverlib/Board", {}, false);

GPIO2.$name                          = "CLK";
GPIO2.associatedPins.create(2);
GPIO2.associatedPins[0].$name        = "WCLK";
GPIO2.associatedPins[0].assignedPort = "PORTB";
GPIO2.associatedPins[0].assignedPin  = "9";
GPIO2.associatedPins[1].$name        = "FQ";
GPIO2.associatedPins[1].assignedPort = "PORTB";
GPIO2.associatedPins[1].assignedPin  = "24";

GPIO3.$name                          = "RST";
GPIO3.associatedPins[0].$name        = "PIN_RST";
GPIO3.associatedPins[0].assignedPort = "PORTA";
GPIO3.associatedPins[0].assignedPin  = "26";

SYSCTL.forceDefaultClkConfig = true;

/**
 * Pinmux solution for unlocked pins/peripherals. This ensures that minor changes to the automatic solver in a future
 * version of the tool will not impact the pinmux you originally saw.  These lines can be completely deleted in order to
 * re-solve from scratch.
 */
GPIO1.associatedPins[0].pin.$suggestSolution = "PA15";
GPIO1.associatedPins[1].pin.$suggestSolution = "PA16";
GPIO1.associatedPins[2].pin.$suggestSolution = "PA17";
GPIO1.associatedPins[3].pin.$suggestSolution = "PA24";
GPIO1.associatedPins[4].pin.$suggestSolution = "PA18";
GPIO1.associatedPins[5].pin.$suggestSolution = "PB18";
GPIO1.associatedPins[6].pin.$suggestSolution = "PA22";
GPIO1.associatedPins[7].pin.$suggestSolution = "PA8";
Board.peripheral.$suggestSolution            = "DEBUGSS";
Board.peripheral.swclkPin.$suggestSolution   = "PA20";
Board.peripheral.swdioPin.$suggestSolution   = "PA19";
GPIO2.associatedPins[0].pin.$suggestSolution = "PB9";
GPIO2.associatedPins[1].pin.$suggestSolution = "PB24";
GPIO3.associatedPins[0].pin.$suggestSolution = "PA26";
SYSCTL.peripheral.$suggestSolution           = "SYSCTL";
